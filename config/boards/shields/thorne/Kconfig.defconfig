## config/boards/shields/thorne/Kconfig.defconfig
```kconfig
if SHIELD_THORNE_LEFT

config ZMK_KEYBOARD_NAME
    default "Thorne"

endif

if SHIELD_THORNE_LEFT

config ZMK_KEYBOARD_NAME
    default "Thorne"

config ZMK_SPLIT_ROLE_CENTRAL
    default y

endif

if SHIELD_THORNE_LEFT || SHIELD_THORNE_RIGHT

config ZMK_SPLIT
    default y

endif
#Display/LED Options
endmenu

menu "Power Management"

config ZMK_IDLE_TIMEOUT
	int "Milliseconds of inactivity before entering idle state (OLED shutoff, etc)"
	default 30000  #30 seconds

config ZMK_SLEEP
	bool "Enable deep sleep support"
	imply USB

if ZMK_SLEEP

config PM_DEVICE
	default y

config ZMK_IDLE_SLEEP_TIMEOUT
	int "Milliseconds of inactivity before entering deep sleep"
	default 900000  #15 minutes

#ZMK_SLEEP
endif

if ZMK_DISPLAY

config I2C
	default y

config SSD1306
	default y

config SSD1306_REVERSE_MODE
	default y

endif # ZMK_DISPLAY

endif
```

## config/boards/shields/thorne/Kconfig.shield
```kconfig
config SHIELD_CORNE_LEFT
   def_bool $(sheilds_list_contains, corne_left)

config SHIELD_CORNE_RIGHT
   def_bool $(sheilds_list_contains, corne_right)
```
